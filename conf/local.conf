## conf/local.conf
```bitbake
MACHINE= "raspberrypi4-64"
LICENSE_FLAGS_ACCEPTED = "synaptics-killswitch"
PARALLEL_MAKE = "-j 4"

EXTRA_IMAGE_FEATURES ?= "allow-empty-password empty-root-password allow-root-login"
USER_CLASSES ?= "buildstats"

CONF_VERSION = "2"

INHERIT += "rm_work"

BUILD_TYPE = "dev"
```
